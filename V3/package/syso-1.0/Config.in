## V3/package/syso-1.0/Config.in
```kconfig
config BR2_PACKAGE_SYSO
	bool "syso"
	default n
	help
	  This is our own Syso Package
	  
	  https://github.com/roroettg/systemsoftware
```

## V3/package/timeinfo/Config.in
```kconfig
config BR2_PACKAGE_TIMEINFO
        bool "timeinfo"
        help
			gives timeinfo
```
